## addons/lpi4a-bt/package/rtk-hciattach/Config.in
```kconfig
config BR2_PACKAGE_RTK_HCIATTACH
	bool "rtk hciattach"
	help
	  rtl8723ds UART utils
```

## addons/lpi4a-bt/package/rtl8723ds-bt-fw/Config.in
```kconfig
config BR2_PACKAGE_RTL8723DS_BT_FW
        bool "rtl8723ds bluetooth firmware"
        help
	  some blob use for rtl8723ds bluetooth
```
